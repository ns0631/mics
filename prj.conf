## CMakeLists.txt
```
# SPDX-License-Identifier: Apache-2.0

cmake_minimum_required(VERSION 3.20.0)

find_package(Zephyr REQUIRED HINTS $ENV{ZEPHYR_BASE})
project(imu)

FILE(GLOB app_sources src/*.c)
target_sources(app PRIVATE ${app_sources})

target_include_directories(app PRIVATE include/)
```

## prj.conf
```kconfig
CONFIG_GPIO=y
CONFIG_NEWLIB_LIBC=y
CONFIG_NEWLIB_LIBC_NANO=n

CONFIG_STDOUT_CONSOLE=y
CONFIG_PRINTK=y
CONFIG_CBPRINTF_FP_SUPPORT=y

CONFIG_PWM=y

CONFIG_SERIAL=y
CONFIG_UART_INTERRUPT_DRIVEN=y
```

## boards/nucleo_f446re.overlay
```dts
/ {
     continuous_servo: td8210mg {
          compatible = "pwm-servo";
          pwms = <&pwm1 1 PWM_MSEC(20) PWM_POLARITY_NORMAL>;
          min-pulse = <PWM_USEC(500)>;
          max-pulse = <PWM_USEC(2500)>;
     };

};

&timers2{
     pwm1: pwm {
          status = "okay";
          pinctrl-0 = <&tim2_ch1_pa5>;
          pinctrl-names = "default";
     };
};
```

## boards/nucleo_l432kc.overlay
```dts
/ {
     continuous_servo: td8210mg {
          compatible = "pwm-servo";
          pwms = <&pwm1 2 PWM_MSEC(20) PWM_POLARITY_NORMAL>;
          min-pulse = <PWM_USEC(500)>;
          max-pulse = <PWM_USEC(2500)>;
     };

};

&timers1{
     pwm1: pwm {
          status = "okay";
          pinctrl-0 = <&tim1_ch2_pa9>;
          pinctrl-names = "default";
     };
};
```

## src/main.c
```c
/*
 * Copyright (c) 2016 Intel Corporation
 *
 * SPDX-License-Identifier: Apache-2.0
 */

/*
Arduino code, adapted for zephyr: https://mschoeffler.com/2017/10/05/tutorial-how-to-use-the-gy-521-module-mpu-6050-breakout-board-with-the-arduino-uno/
Following tutorial from here: https://academy.nordicsemi.com/topic/i2c-driver/
For complementary filter: https://www.hackster.io/hibit/complementary-filter-and-relative-orientation-with-mpu9250-d4f79d#toc-gyroscope-angles-3
Register map: https://invensense.tdk.com/wp-content/uploads/2015/02/MPU-6000-Register-Map1.pdf
Datasheet: https://invensense.tdk.com/wp-content/uploads/2015/02/MPU-6000-Datasheet1.pdf
*/

#include <stdio.h>
#include <zephyr/kernel.h>
#include <zephyr/drivers/gpio.h>
#include <zephyr/sys/printk.h>

#include <stdlib.h>

#include <zephyr/kernel.h>
#include <zephyr/device.h>
#include <zephyr/drivers/uart.h>

#include <string.h>

#include "servos.h"
#include "pid.h"

/* change this to any other UART peripheral if desired */
#define UART_DEVICE_NODE DT_CHOSEN(zephyr_shell_uart)

#define MSG_SIZE 32

/* queue to store up to 10 messages (aligned to 4-byte boundary) */
K_MSGQ_DEFINE(uart_msgq, MSG_SIZE, 10, 4);

static const struct device *const uart_dev = DEVICE_DT_GET(UART_DEVICE_NODE);

/* receive buffer used in UART ISR callback */
static char rx_buf[MSG_SIZE];
static int rx_buf_pos;

/*
 * Read characters from UART until line end is detected. Afterwards push the
 * data to the message queue.
 */
void serial_cb(const struct device *dev, void *user_data)
{
	uint8_t c;

	if (!uart_irq_update(uart_dev)) {
		return;
	}

	if (!uart_irq_rx_ready(uart_dev)) {
		return;
	}

	/* read until FIFO empty */
	while (uart_fifo_read(uart_dev, &c, 1) == 1) {
		if ((c == '\n' || c == '\r') && rx_buf_pos > 0) {
			/* terminate string */
			rx_buf[rx_buf_pos] = '\0';

			/* if queue is full, message is silently dropped */
			k_msgq_put(&uart_msgq, &rx_buf, K_NO_WAIT);

			/* reset the buffer (it was copied to the msgq) */
			rx_buf_pos = 0;
		} else if (rx_buf_pos < (sizeof(rx_buf) - 1)) {
			rx_buf[rx_buf_pos++] = c;
		}
		/* else: characters beyond buffer size are dropped */
	}
}

/*
 * Print a null-terminated string character by character to the UART interface
 */
void print_uart(char *buf)
{
	int msg_len = strlen(buf);

	for (int i = 0; i < msg_len; i++) {
		uart_poll_out(uart_dev, buf[i]);
	}
}

int main(void)
{
	char tx_buf[MSG_SIZE];
	float stated_angle, change;
	int start, end;

	setup_continuous_servo();

	if (!device_is_ready(uart_dev)) {
		printk("UART device not found!");
		return 0;
	}

	/* configure interrupt and callback to receive data */
	int ret = uart_irq_callback_user_data_set(uart_dev, serial_cb, NULL);

	if (ret < 0) {
		if (ret == -ENOTSUP) {
			printk("Interrupt-driven UART API support not enabled\n");
		} else if (ret == -ENOSYS) {
			printk("UART device does not support interrupt-driven API\n");
		} else {
			printk("Error setting UART callback: %d\n", ret);
		}
		return 0;
	}
	uart_irq_rx_enable(uart_dev);

	print_uart("Hello! I'm your echo bot.\r\n");
	print_uart("Tell me something and press enter:\r\n");

	/* indefinitely wait for input from the user */
	start = k_uptime_get();
	while (k_msgq_get(&uart_msgq, &tx_buf, K_FOREVER) == 0) {
		print_uart("Echo: ");
		print_uart(tx_buf);
		print_uart("\r\n");
		stated_angle = atof(tx_buf);
		end = k_uptime_get();
		change = pid(stated_angle, 1e-2);
		start = end;
		move_continuous_servo(change);

		while(1){
			if(k_uptime_get() - end > 150){
				move_continuous_servo(0);
				break;
			}
		}

	}
	return 0;
}
```

## include/pid.h
```c
float pid(float current, double dT);
```

## include/servos.h
```c
void setup_continuous_servo();

void move_continuous_servo(float PID_output);
```

## src/pid.c
```c
//Mostly copied from here: https://wired.chillibasket.com/2015/03/pid-controller/

#include "pid.h"

// Declare variables
static float Kp = 3.;          // (P)roportional Tuning Parameter
static float Ki = 5e-5;          // (I)ntegral Tuning Parameter        
static float Kd = 0;          // (D)erivative Tuning Parameter       
float iTerm = 0;       // Used to accumulate error (integral)
float lastTime = 0;    // Records the time the function was last called
static float maxPID = 20000;    // The maximum value that can be output
float oldValue = 0;    // The last sensor value
float target = 90;//0;

float pid(float current, double dT) {
	// Calculate error between target and current values
	float error = target - current;

	// Calculate the integral term
	iTerm += error * dT; 

	// Calculate the derivative term (using the simplification)
	float dTerm = (oldValue - current) / dT;

	// Set old variable to equal new ones
	oldValue = current;

	// Multiply each term by its constant, and add it all up
	float result = (error * Kp) + (iTerm * Ki) + (dTerm * Kd);

	// Limit PID value to maximum values
	if (result > maxPID) result = maxPID;
	else if (result < -maxPID) result = -maxPID;
	//printk("P term: %f; I term: %f; D term: %f; error: %f; result: %f\n", error * Kp, (iTerm * Ki), (dTerm * Kd), error, result);

	return result;
}
```

## src/servos.c
```c
#include <zephyr/kernel.h>
#include <zephyr/sys/printk.h>
#include <zephyr/device.h>
#include <zephyr/drivers/pwm.h>

#include "servos.h"

static const struct pwm_dt_spec continuous_servo = PWM_DT_SPEC_GET(DT_NODELABEL(continuous_servo));

static const uint32_t min_pulse_continuous = 1000;//DT_PROP(DT_NODELABEL(continuous_servo), min_pulse) / 1000;
static const uint32_t max_pulse_continuous = 2000;//DT_PROP(DT_NODELABEL(continuous_servo), max_pulse) / 1000;

static float prev_angle = 0;
static float current_angle = 0;

void move_continuous_servo(float PID_output){
	int pwm_range = max_pulse_continuous - min_pulse_continuous;
	int half_range = pwm_range / 2;

	int middle_pulse = (max_pulse_continuous + min_pulse_continuous) / 2;

	//uint32_t pulse_width = min_pulse + pwm_range * angle / 120;
	uint32_t pulse_width = middle_pulse - half_range * PID_output / 10;

	if(pulse_width > max_pulse_continuous){
		pulse_width = max_pulse_continuous;
	} else if (pulse_width < min_pulse_continuous){
		pulse_width = min_pulse_continuous;
	}

	printk("PWM pulse width: %d\n", pulse_width);

	int ret = pwm_set_pulse_dt(&continuous_servo, PWM_USEC(pulse_width));
	if (ret < 0) {
		printk("Error %d: failed to set pulse width\n", ret);
	}
}

void setup_continuous_servo(){
	if (!device_is_ready(continuous_servo.dev)) {
		printk("Error: PWM device %s is not ready\n", continuous_servo.dev->name);
	}
	int ret = pwm_set_pulse_dt(&continuous_servo, PWM_USEC(1500));
	if (ret < 0) {
		printk("Error %d: failed to set pulse width\n", ret);
	}
}
```
